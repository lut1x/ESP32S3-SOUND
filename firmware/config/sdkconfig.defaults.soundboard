## firmware/config/sdkconfig.defaults.soundboard
```kconfig
# Custom ESP32-S3-N16R8, four MAX98357A; UART0 programming.
CONFIG_BOARD_ESP32S3_GENERIC=y
CONFIG_ESPTOOLPY_FLASHSIZE_16MB=y
CONFIG_ESPTOOLPY_FLASHSIZE="16MB"
CONFIG_SPIRAM_MODE_OCT=y
CONFIG_ESP_CONSOLE_UART_DEFAULT=y
CONFIG_AUDIO_OUTPUT_I2S=y
CONFIG_AIRPLAY_SENDER_VOLUME_ONLY=y
CONFIG_OUTPUT_SAMPLE_RATE_44100=y
CONFIG_I2S_SCK_IO=-1
CONFIG_I2S_BCK_IO=3
CONFIG_I2S_WS_IO=9
CONFIG_I2S_DO_IO=14
CONFIG_I2S_GND_IO=-1
CONFIG_I2S_VCC_IO=-1
CONFIG_I2S_MIRROR_MAX98357_BOARD=y
CONFIG_LED_STATUS_GPIO=-1
CONFIG_LED_ERROR_GPIO=-1
CONFIG_LED_RGB_GPIO=-1
CONFIG_BAT_CHANNEL=-1
CONFIG_DAC_I2C_SDA=-1
CONFIG_DAC_I2C_SCL=-1
CONFIG_DAC_PDN_GPIO=-1
CONFIG_DAC_PDN2_GPIO=-1
CONFIG_MUTE_GPIO=-1
# CONFIG_DAC_TAS57XX is not set
# CONFIG_DAC_TAS58XX is not set
# CONFIG_DAC_ES8311 is not set
# CONFIG_DISPLAY_ENABLED is not set
```
